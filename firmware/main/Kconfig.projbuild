## firmware/main/Kconfig.projbuild
```kconfig
menu "Addison Weather"
    config WEATHER_WIFI_SSID
        string "Wi-Fi SSID (2.4 GHz)"
        default "your-ssid"
    config WEATHER_WIFI_PASSWORD
        string "Wi-Fi password"
        default "your-password"
    config WEATHER_IMAGE_URL
        string "URL of weather.bin"
        default "https://YOUR-GITHUB-USER.github.io/addison-weather/weather.bin"
    config WEATHER_REFRESH_MINUTES
        int "Minutes between updates"
        default 60
    config WEATHER_RETRY_MINUTES
        int "Minutes before retry after a failed update"
        default 15
endmenu
```

## firmware/sdkconfig.defaults
```kconfig
CONFIG_IDF_TARGET="esp32s3"
CONFIG_ESPTOOLPY_FLASHSIZE_16MB=y
CONFIG_MBEDTLS_CERTIFICATE_BUNDLE=y
CONFIG_MBEDTLS_CERTIFICATE_BUNDLE_DEFAULT_FULL=y
CONFIG_ESP_CONSOLE_USB_SERIAL_JTAG=y
```
